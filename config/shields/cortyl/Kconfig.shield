## config/shields/cortyl/Kconfig.shield
```kconfig
# No whitespace after the comma or in your part name!
config SHIELD_CORTYL_LEFT
    def_bool $(shields_list_contains,cortyl_left)

# No whitespace after the comma or in your part name!
config SHIELD_CORTYL_RIGHT
    def_bool $(shields_list_contains,cortyl_right)
```
